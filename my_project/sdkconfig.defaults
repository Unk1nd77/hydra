## my_project/sdkconfig.defaults
```kconfig
# WiFi Configuration
CONFIG_ESP8266_WIFI_STATIC_RX_BUFFER_NUM=16
CONFIG_ESP8266_WIFI_DYNAMIC_RX_BUFFER_NUM=32
CONFIG_ESP8266_WIFI_DYNAMIC_TX_BUFFER_NUM=32
CONFIG_ESP8266_WIFI_TX_BA_WIN=6
CONFIG_ESP8266_WIFI_RX_BA_WIN=6

# FreeRTOS Configuration
CONFIG_FREERTOS_HZ=1000

# Memory Configuration
CONFIG_ESP8266_IRAM_SIZE=0x8000
CONFIG_ESP8266_ICACHE_SIZE=0x4000
CONFIG_ESP8266_DCACHE_SIZE=0x4000

# Partition Table
CONFIG_PARTITION_TABLE_CUSTOM=y
CONFIG_PARTITION_TABLE_CUSTOM_FILENAME="partitions.csv"

# SPIFFS Configuration
CONFIG_SPIFFS_MAX_PARTITIONS=3
```
